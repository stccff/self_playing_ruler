## v1/code/main/Kconfig.projbuild
```kconfig
menu "Ruler Instrument Configuration"
    # config DEBUG_PRINT
    #     bool "Enable debug log print"
    #     default n
    #     help
    #         Enable or disable printing of debug information.

    choice RULER_INSTRUMENT_HARDWARE_VERSION
        prompt "Hardware version"
        help
            To adapte different hw version
        default HW_A_VER_1_1

        config HW_A_VER_1_0
            bool "A_V1.0"

        config HW_A_VER_1_1
            bool "A_V1.1"

        config HW_B_VER_1_0
            bool "B_V1.0"
    endchoice

    config HW_A_VER_1
        bool
        default y if HW_A_VER_1_0 || HW_A_VER_1_1
        default n
        help
            Automatically set for any A-series hardware
endmenu
```
