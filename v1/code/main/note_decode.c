#include "esp_err.h"
#include "note_decode.h"
#include "esp_log.h"
#include "string.h"

/* ***************************************************************************************************************** */
/*                                               macro define                                                        */
/* ***************************************************************************************************************** */
#define TAG "NOTE_DECODE"
/* ***************************************************************************************************************** */
/*                                               struct define                                                       */
/* ***************************************************************************************************************** */

/* ***************************************************************************************************************** */
/*                                               global variable                                                     */
/* ***************************************************************************************************************** */
static const float g_midi_freq[128] = {
    8.18,    8.66,    9.18,    9.72,    10.3,    10.91,   11.56,   12.25,
    12.98,   13.75,   14.57,   15.43,   16.35,   17.32,   18.35,   19.45,
    20.6,    21.83,   23.12,   24.5,    25.96,   27.5,    29.14,   30.87,
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    8372.02, 8869.84, 9397.27, 9956.06, 10548.08, 11175.3, 11839.82, 12543.85,
};


static const int g_scale_offset[10][7] = {
    {0, 2, 4, 5, 7, 9, 11}, // Major
    {0, 2, 3, 5, 7, 8, 10}, // Natual minor
    {0, 2, 3, 5, 7, 8, 11}, // Harmonic minor
    {0, 2, 3, 5, 7, 9, 11}, // Melodic minor
    {0, 2, 4, 5, 7, 9, 10}, // Dorian
    {0, 1, 3, 5, 7, 8, 10}, // Phrygian
    {0, 2, 4, 6, 7, 9, 11}, // Lydian
    {0, 2, 4, 5, 7, 9, 10}, // Mixolydian
    {0, 2, 3, 5, 7, 9, 10}, // Aeolian
    {0, 2, 4, 6, 7, 9, 11}, // Locrian
};

static int g_base = 48; // C3
static int g_scale = 0; // Major

/* ***************************************************************************************************************** */
/*                                           function prototype                                                      */
/* ***************************************************************************************************************** */



/**
 * @brief Parsing simple notation to midi number
 *
 * @param note  simple notation like "1", "2.", ".2", "#1", "b2", "1#", "1.b", "1.."
 * @return int  midi number
 */
int parse_simple_note_to_midi(const char *note)
{
    int dots_below = 0;
    int dots_above = 0;
    int note_num = 0;
    int accidentals = 0;  // 升降号计数器

    const char* p = note;

    // 解析下方点
    while (*p == '.') {
        dots_below++;
        p++;
    }

    // 解析数字前升降号
    while (*p == '#' || *p == 'b') {
        accidentals += (*p == '#') ? 1 : -1;
        p++;
    }

    // 解析音符数字
    note_num = *p - '0';
    p++;

    // 解析数字后升降号
    while (*p == '#' || *p == 'b') {
        accidentals += (*p == '#') ? 1 : -1;
        p++;
    }

    // 解析上方点
    while (*p == '.') {
        dots_above++;
        p++;
    }

    // 计算MIDI编号
    int octave_shift = dots_above - dots_below;
    int midi = g_base + g_scale_offset[g_scale][note_num - 1] + octave_shift * 12 + accidentals;;

    // 计算时值（示例：假设4分音符为480 ticks）
    // int duration = 480; // 默认四分音符

    return midi;
}

/**
 * @brief convert midi number to frequency
 *
 * @param midi
 * @return float
 */
float convert_midi_to_freq(int midi)
{
    return g_midi_freq[midi];
}

int set_base_and_scale(int base, int scale)
{
    if (base < 0 || base > 127) {
        return ESP_ERR_INVALID_ARG;
    }
    if (scale < 0 || scale > 9) {
        return ESP_ERR_INVALID_ARG;
    }
    g_base = base;
    g_scale = scale;
    ESP_LOGI(TAG, "Set base to %d, scale to %d", g_base, g_scale);

    return ESP_OK;
}
